## arch/arm/mach-msm/lge/u0/Kconfig
```kconfig
config MACH_MSM7X27A_U0
    depends on ARCH_MSM7X27A
    depends on !MSM_STACKED_MEMORY
    select MACH_LGE
    bool "MSM7x27A U0"
    help
        Support for the LG Electronics MSM7x27A U0.

config MACH_MSM7X27A_U0_NO_DEBUG
    depends on MACH_MSM7X27A_U0
	default n
    bool "MSM7x27A U0 DEBUG Option"
    help
        Support for the LG Electronics MSM7x27A U0.
```

## arch/arm/mach-msm/lge/vee3/Kconfig
```kconfig
config MACH_MSM7X25A_V3
    depends on ARCH_MSM7X27A
    depends on !MSM_STACKED_MEMORY
    select MACH_LGE
    bool "MSM7x25A V3"
    help
        Support for the LG Electronics MSM7x25A V3.

config MACH_MSM7X25A_V3_DS
    depends on ARCH_MSM7X27A
    depends on !MSM_STACKED_MEMORY
    depends on MACH_MSM7X25A_V3
    select MACH_LGE
    bool "MSM7x25A V3 DS"
    help
        Support for the LG Electronics MSM7x25A V3 DualSim.

config MACH_MSM7X25A_V3_WORKAROUD_BUG
    depends on ARCH_MSM7X27A
    depends on !MSM_STACKED_MEMORY
    depends on MACH_MSM7X25A_V3
    select MACH_LGE
    bool "MSM7x25A V3 WorkAround BUG"
    default y
    help
        Workaround for bug of screen still awake after lock.
```
